## west.yml
```yaml
# Copyright (c) 2023-2025 tinyVision.ai Inc.
# SPDX-License-Identifier: MIT

manifest:
  projects:
    - name: zephyr
      url: https://github.com/zephyrproject-rtos/zephyr
      revision: v4.2.0
      import:
        name-allowlist:
          - zephyr
          - fatfs
          - mcuboot
```

## zephyr/boards/tinyvision/tinyclunx33/Kconfig.defconfig
```kconfig
# Copyright (c) 2024 tinyVision.ai Inc.
# SPDX-License-Identifier: Apache-2.0

# Workaround for not being able to have commas in macro arguments
DT_CHOSEN_Z_CODE_PARTITION := zephyr,code-partition

config HAS_FLASH_LOAD_OFFSET
	default y

config FLASH_LOAD_SIZE
	default $(dt_chosen_reg_size_hex,$(DT_CHOSEN_Z_CODE_PARTITION))

config FLASH_LOAD_OFFSET
	default $(dt_chosen_reg_addr_hex,$(DT_CHOSEN_Z_CODE_PARTITION))

config CLOCK_CONTROL
	# For the external clock that provides the CPU its crystal-based clock
	default y

config CLOCK_CONTROL_INIT_PRIORITY
	# Because the PLL is on I2C, it needs to be loaded late in the process
	# before this happens, the system will be running off the internal
	# oscillator
	default 50

config I2C
	# Some I2C peripherals are on the SoM itself
	default y

config I2C_PCA9542A_ROOT_INIT_PRIO
	default 50

config I2C_PCA9542A_CHANNEL_INIT_PRIO
	default 51

config XIP
	default y

config SERIAL
	default y

config CONSOLE
	default y

config UART_CONSOLE
	default y

config UART_LINE_CTRL
	default y

config SYS_CLOCK_HW_CYCLES_PER_SEC
    default $(dt_node_int_prop_int,/clocks/cpu_clock,clock-frequency)
```

## zephyr/boards/tinyvision/tinyclunx33/Kconfig.tinyclunx33
```kconfig
# Copyright (c) 2024-2025 tinyVision.ai Inc.
# SPDX-License-Identifier: Apache-2.0

config BOARD_TINYCLUNX33
	select SOC_TINYCLUNX33_RTL_1_0 if BOARD_TINYCLUNX33_RTL_1_0
	select SOC_TINYCLUNX33_RTL_1_1 if BOARD_TINYCLUNX33_RTL_1_1
	select SOC_TINYCLUNX33_RTL_1_2 if BOARD_TINYCLUNX33_RTL_1_2
```

## zephyr/boards/tinyvision/tinyclunx33/board.yml
```yaml
board:
  name: tinyclunx33
  full_name: tinyVision.ai tinyCLUNX33
  vendor: tinyvision
  revision:
    format: custom
    default: "rev2"
    exact: true
    revisions:
      - name: "rev1"
      - name: "rev2"
      - name: "rev3"
  socs:
    - name: rtl_1_0
    - name: rtl_1_1
    - name: rtl_1_2
```

## zephyr/drivers/Kconfig
```kconfig
# Copyright (c) 2024 tinyVision.ai Inc.
# SPDX-License-Identifier: Apache-2.0

rsource "clock_control/Kconfig"
rsource "i2c/Kconfig"
rsource "flash/Kconfig"
rsource "usb/udc/Kconfig"
rsource "video/Kconfig"
```

## zephyr/drivers/debug/Kconfig.spinex
```kconfig
# Copyright (c) 2025 Silicon Laboratories Inc.
# SPDX-License-Identifier: Apache-2.0

config DEBUG_SPINEX_EVENT_LOGGER
	bool "Spinex event logging interface"
    default y
    depends on DT_HAS_SPINEX_EVENT_LOGGER_ENABLED
    help
      Provide shell for spinex event logger

config DEBUG_SPINEX_REG_FILE
	bool "Spinex event reg file shell tool"
    default y
    depends on DT_HAS_SPINEX_REG_FILE_ENABLED
    help
      Provide shell for spinex reg files
```

## zephyr/drivers/flash/Kconfig
```kconfig
# Copyright (c) 2025 tinyVision.ai Inc.
# SPDX-License-Identifier: Apache-2.0

if FLASH

rsource "Kconfig.tinyvision"

endif
```

## zephyr/drivers/flash/Kconfig.memcpy
```kconfig
# Copyright (c) 2025 tinyVision.ai Inc.
# SPDX-License-Identifier: Apache-2.0

config FLASH_MEMCPY
	bool "Read-only memcpy()-based flash driver"
	default y
	depends on DT_HAS_ZEPHYR_FLASH_MEMCPY_ENABLED
	select FLASH_HAS_DRIVER_ENABLED
	select FLASH_HAS_PAGE_LAYOUT
	help
	  Enable support for memcpy()-based flash driver
```

## zephyr/drivers/flash/Kconfig.tinyvision
```kconfig
config FLASH_TINYVISION
	bool "tinyVision Flash driver"
	default y
	depends on DT_HAS_TINYVISION_FLASH_ENABLED
	select FLASH_HAS_DRIVER_ENABLED
	select FLASH_HAS_PAGE_LAYOUT
	select FLASH_HAS_EXPLICIT_ERASE
	select CODE_DATA_RELOCATION
	help
	  Enable support for tinyVision Flash driver
```

## zephyr/dts/bindings/debug/spinex,event-logger.yaml
```yaml
compatible: "spinex,event-logger"

description: |
  Spinex event logger entry

properties:
  reg:
    type: array
  reg-names:
    type: string-array
```

## zephyr/dts/bindings/debug/spinex,reg-file.yaml
```yaml
compatible: "spinex,reg-file"

description: |
  Spinex reg file documentation

properties:
  reg:
    type: array
  reg-names:
    type: string-array
  reg-docs:
    type: string-array
    required: true
```

## zephyr/dts/bindings/flash/tinyvision,flash.yaml
```yaml
# Copyright (c) 2025 tinyVision.ai
# SPDX-License-Identifier: Apache-2.0

description: tinyVision.ai Flash

compatible: "tinyvision,flash"

include: flash-controller.yaml

properties:
  reg:
    required: true
```

## zephyr/dts/bindings/flash/zephyr,flash-memcpy.yaml
```yaml
# Copyright (c) 2025 tinyVision.ai
# SPDX-License-Identifier: Apache-2.0

description: memcpy()-based flash controller

compatible: "zephyr,flash-memcpy"

include: base.yaml
```

## zephyr/dts/bindings/i2c/opencores,i2c.yaml
```yaml
#
# Copyright (c) 2019 Antmicro <www.antmicro.com>
#
# SPDX-License-Identifier: Apache-2.0
#

description: opencores I2C controller

compatible: "opencores,i2c"

include: i2c-controller.yaml

properties:
  reg:
    required: true

  clock-frequency:
    required: true

  rtl-version:
    type: int
    description: 0 for litex RTL, 1 for opencores
```

## zephyr/soc/tinyvision/tinyclunx33/Kconfig
```kconfig
# Copyright (c) 2018 - 2019 Antmicro <www.antmicro.com>
# Copyright (c) 2024 - 2025 tinyVision.ai Inc.
# SPDX-License-Identifier: Apache-2.0

config SOC_SERIES_TINYCLUNX33
	select RISCV
	select ATOMIC_OPERATIONS_C
	select INCLUDE_RESET_VECTOR
	select RISCV_ISA_RV32I
	select RISCV_ISA_EXT_M
	select RISCV_ISA_EXT_ZICSR
	select RISCV_ISA_EXT_ZIFENCEI
	select ARCH_HAS_NOCACHE_MEMORY_SUPPORT
	select CPU_HAS_DCACHE
	select CPU_HAS_ICACHE
	imply XIP

if SOC_SERIES_TINYCLUNX33

config LITEX_CSR_DATA_WIDTH
	int "LiteX Control/Status registers are 32-bit as used by litex,uart"
	default 32

config CODE_DATA_RELOCATION
	depends on SPI
	default y

endif # SOC_SERIES_TINYCLUNX33
```

## zephyr/soc/tinyvision/tinyclunx33/Kconfig.defconfig
```kconfig
# Copyright (c) 2024, tinyVision.ai Inc.
# SPDX-License-Identifier: Apache-2.0

if SOC_SERIES_TINYCLUNX33

config SYS_CLOCK_HW_CYCLES_PER_SEC
	default 80000000

config NUM_IRQS
	default 12

config SHELL_BACKEND_SERIAL_CHECK_DTR
	# Usability fix: wait that the client connects before sending the prompt
	default y

# Does not use the video_enqueue/dequeue() interface, no need for any video or UVC buffer

config VIDEO_BUFFER_POOL_SZ_MAX
	default 1

config VIDEO_BUFFER_POOL_NUM_MAX
	default 0

config USBD_VIDEO_NUM_BUFS
	default 0

endif # SOC_SERIES_TINYCLUNX33
```

## zephyr/soc/tinyvision/tinyclunx33/Kconfig.soc
```kconfig
# Copyright (c) 2024 tinyVision.ai Inc.
# SPDX-License-Identifier: Apache-2.0

config SOC_SERIES_TINYCLUNX33
	bool "tinyCLUNX33 RTL-basd SoC"
	help
	  Each SoC under this series is a release of an FPGA RTL ("gateware")
	  that implements the virtual SoC loaded onto the FPGA. They are
	  published by tinyVision.ai.

config SOC_TINYCLUNX33_RTL_1_0
	bool "tinyCLUNX33 RTL v1.0.* releases"
	select SOC_SERIES_TINYCLUNX33
	help
	  The tinyCLUNX33 RTL v1.0.* releases.

config SOC_TINYCLUNX33_RTL_1_1
	bool "tinyCLUNX33 RTL v1.1.* releases"
	select SOC_SERIES_TINYCLUNX33
	help
	  The tinyCLUNX33 RTL v1.1.* releases.

config SOC_TINYCLUNX33_RTL_1_2
	bool "tinyCLUNX33 RTL v1.2.* releases"
	select SOC_SERIES_TINYCLUNX33
	help
	  The tinyCLUNX33 RTL v1.2.* releases.

config SOC_SERIES
	default "tinyclunx33" if SOC_SERIES_TINYCLUNX33

config SOC
	default "rtl_1_0" if SOC_TINYCLUNX33_RTL_1_0
	default "rtl_1_1" if SOC_TINYCLUNX33_RTL_1_1
	default "rtl_1_2" if SOC_TINYCLUNX33_RTL_1_2
```

## zephyr/subsys/usb/device_next/Kconfig
```kconfig
# Copyright (c) 2025 tinyVision.ai Inc.
# SPDX-License-Identifier: Apache-2.0

if USB_DEVICE_STACK_NEXT

rsource "class/Kconfig.cdc_raw"
rsource "class/Kconfig.cdc_mute"
rsource "class/Kconfig.uvc"

endif # USB_DEVICE_STACK_NEXT
```

## zephyr/subsys/usb/device_next/class/Kconfig.cdc_mute
```kconfig
# Copyright (c) 2025 tinyVision.ai Inc.
#
# SPDX-License-Identifier: Apache-2.0

config USBD_CDC_MUTE_CLASS
	bool "USB CDC MUTE implementation [EXPERIMENTAL]"
	help
	  USB device CDC MUTE class implementation.

if USBD_CDC_MUTE_CLASS

config USBD_CDC_MUTE_STACK_SIZE
	int "USB CDC MUTE workqueue stack size"
	default 1024
	help
	  USB CDC MUTE workqueue stack size.

module = USBD_CDC_MUTE
module-str = usbd cdc_mute
default-count = 1
source "subsys/logging/Kconfig.template.log_config"

endif
```

## zephyr/subsys/usb/device_next/class/Kconfig.cdc_raw
```kconfig
# Copyright (c) 2025 tinyVision.ai Inc.
#
# SPDX-License-Identifier: Apache-2.0

config USBD_CDC_RAW_CLASS
	bool "USB CDC RAW implementation [EXPERIMENTAL]"
	help
	  USB device CDC RAW class implementation.

if USBD_CDC_RAW_CLASS

config USBD_CDC_RAW_STACK_SIZE
	int "USB CDC RAW workqueue stack size"
	default 1024
	help
	  USB CDC RAW workqueue stack size.

module = USBD_CDC_RAW
module-str = usbd cdc_raw
default-count = 1
source "subsys/logging/Kconfig.template.log_config"

endif
```
