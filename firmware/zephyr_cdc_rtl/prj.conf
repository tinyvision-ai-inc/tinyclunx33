## prj.conf
```kconfig
CONFIG_ASSERT=y

# Shell
CONFIG_SHELL=y
CONFIG_I2C_SHELL=y
CONFIG_KERNEL_SHELL=y

# USB
CONFIG_USB_DEVICE_STACK_NEXT=y
CONFIG_USBD_CDC_RAW_CLASS=y

# Logging
CONFIG_LOG=y
CONFIG_LOG_MODE_MINIMAL=y
CONFIG_UDC_DRIVER_LOG_LEVEL_INF=y
CONFIG_USBD_LOG_LEVEL_INF=y
CONFIG_USBD_CDC_RAW_LOG_LEVEL_INF=y
```

## app.overlay
```dts
/*
 * Copyright (c) 2025 tinyVision.ai Inc.
 *
 * SPDX-License-Identifier: Apache-2.0
 */

&zephyr_udc0 {
	num-in-endpoints = <3>;
	num-out-endpoints = <2>;
	status = "okay";

	cdc0: zephyr_cdc0 {
		compatible = "zephyr,cdc-raw";
	};
};
```

## src/main.c
```c
#include <zephyr/kernel.h>
#include <zephyr/devicetree.h>
#include <zephyr/net_buf.h>
#include <zephyr/drivers/usb/udc.h>
#include <zephyr/drivers/clock_control.h>
#include <zephyr/usb/class/usb_cdc_raw.h>
#include <zephyr/logging/log.h>

LOG_MODULE_REGISTER(app, LOG_LEVEL_DBG);

static const struct device *const cdc0_dev = DEVICE_DT_GET(DT_NODELABEL(cdc0));

int app_usb_init(void);

int main(void)
{
	int ret = 0;

	/* Start the USB stack */
	ret = app_usb_init();
	if (ret != 0) {
		LOG_ERR("Failed to initialize USB");
		return ret;
	}

	/* Wait that the user reacts */
	while (!cdc_raw_is_ready(cdc0_dev)) {
		k_sleep(K_MSEC(10));
	}

	LOG_DBG("CDC raw is ready");

	k_sleep(K_FOREVER);
	return 0;
}
```
