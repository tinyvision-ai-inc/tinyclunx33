/*
 * Copyright (c) tinyVision.ai Inc.
 *
 * SPDX-License-Identifier: Apache-2.0
 */

/dts-v1/;

#include <riscv/tinyvision/tinyclunx33_rtl_1_2.dtsi>
#include "tinyclunx33_common.dtsi"

/ {
	chosen {
		zephyr,code-partition = &slot0_partition;
	};
};
