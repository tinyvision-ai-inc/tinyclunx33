/*
 * Copyright (c) 2025 tinyVision.ai Inc.
 *
 * SPDX-License-Identifier: Apache-2.0
 */

&i2c0 {
	pll: si5351@60 {
		compatible = "skyworks,si5351";
		reg = <0x60>;
		#clock-cells = <0>;
	};
};

csi_i2c: &i2c0ch0 {};
