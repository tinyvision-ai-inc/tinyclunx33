/*
 * Copyright (c) 2025 tinyVision.ai Inc.
 *
 * SPDX-License-Identifier: Apache-2.0
 */

&i2c0 {
	status = "okay";

	pca9542a@71 {
		compatible = "nxp,pca9542a";
		reg = <0x71>;
		#address-cells = <1>;
		#size-cells = <0>;

		i2c0ch0: ch@0 {
			compatible = "nxp,pca9542a-channel";
			reg = <0>;
			#address-cells = <1>;
			#size-cells = <0>;
		};

		i2c0ch1: ch@1 {
			compatible = "nxp,pca9542a-channel";
			reg = <1>;
			#address-cells = <1>;
			#size-cells = <0>;
		};
	};
};

csi_i2c: &i2c0ch0 {};
