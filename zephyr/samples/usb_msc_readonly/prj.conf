## CMakeLists.txt
```
cmake_minimum_required(VERSION 3.20.0)
find_package(Zephyr REQUIRED HINTS $ENV{ZEPHYR_BASE})
project(app)
target_sources(app PRIVATE src/main.c)
```

## Kconfig
```
source "$(srctree)/Kconfig.zephyr"
```

## prj.conf
```kconfig
CONFIG_ASSERT=y
CONFIG_FAT_FILESYSTEM_ELM=y
CONFIG_FILE_SYSTEM=y
CONFIG_FLASH=y
CONFIG_FLASH_PAGE_LAYOUT=y
CONFIG_FLASH_SHELL=y
CONFIG_FLASH_SHELL_TEST_COMMANDS=y
CONFIG_I2C_SHELL=y
CONFIG_KERNEL_SHELL=y
CONFIG_LOG=y
CONFIG_LOG_MODE_MINIMAL=y
CONFIG_MAIN_STACK_SIZE=2048
CONFIG_SHELL=y
CONFIG_UDC_DRIVER_LOG_LEVEL_INF=y
CONFIG_USBD_LOG_LEVEL_INF=y
CONFIG_USBD_MSC_CLASS=y
CONFIG_USBD_MSC_LUNS_PER_INSTANCE=3
CONFIG_USB_DEVICE_STACK_NEXT=y
```

## app.overlay
```dts
/*
 * Copyright (c) 2025 tinyVision.ai Inc.
 *
 * SPDX-License-Identifier: Apache-2.0
 */

/ {
	msc_disk0 {
		compatible = "zephyr,flash-disk";
		partition = <&storage_partition>;
		disk-name = "NAND";
		cache-size = <4096>;
	};
};

&zephyr_udc0 {
	num-in-endpoints = <3>;
	num-out-endpoints = <2>;
	status = "okay";
};
```

## src/main.c
```c
/*
 * Copyright (c) 2016 Intel Corporation.
 * Copyright (c) 2019-2020 Nordic Semiconductor ASA
 * Copyright (c) tinyVision.ai Inc.
 *
 * SPDX-License-Identifier: Apache-2.0
 */

#include <stdio.h>

#include <zephyr/kernel.h>
#include <zephyr/logging/log.h>
#include <zephyr/usb/usb_device.h>
#include <zephyr/usb/usbd.h>
#include <zephyr/usb/class/usbd_msc.h>
#include <zephyr/fs/fs.h>
#include <zephyr/storage/flash_map.h>

#include <ff.h>

LOG_MODULE_REGISTER(main);

#if !defined(CONFIG_DISK_DRIVER_FLASH)
#error No supported disk driver enabled
#endif

#define STORAGE_PARTITION_ID FIXED_PARTITION_ID(storage_partition)

int app_usb_init(void);

static struct fs_mount_t fs_mnt;

USBD_DEFINE_MSC_LUN(nand, "NAND", "Zephyr", "FlashDisk", "0.00");

static int setup_flash(struct fs_mount_t *mnt)
{
	int rc = 0;
	unsigned int id;
	const struct flash_area *pfa;

	mnt->storage_dev = (void *)STORAGE_PARTITION_ID;
	id = STORAGE_PARTITION_ID;

	rc = flash_area_open(id, &pfa);
	printk("Area %u at 0x%x on %s for %u bytes\n",
	       id, (unsigned int)pfa->fa_off, pfa->fa_dev->name,
	       (unsigned int)pfa->fa_size);

	if (rc < 0 && IS_ENABLED(CONFIG_APP_WIPE_STORAGE)) {
		printk("Erasing flash area ... ");
		rc = flash_area_flatten(pfa, 0, pfa->fa_size);
		printk("%d\n", rc);
	}

	if (rc < 0) {
		flash_area_close(pfa);
	}

	return rc;
}

static int mount_app_fs(struct fs_mount_t *mnt)
{
	int rc;

	static FATFS fat_fs;

	mnt->type = FS_FATFS;
	mnt->fs_data = &fat_fs;
	if (IS_ENABLED(CONFIG_DISK_DRIVER_RAM)) {
		mnt->mnt_point = "/RAM:";
	} else if (IS_ENABLED(CONFIG_DISK_DRIVER_SDMMC)) {
		mnt->mnt_point = "/SD:";
	} else {
		mnt->mnt_point = "/NAND:";
	}

	rc = fs_mount(mnt);

	return rc;
}

static void setup_disk(void)
{
	struct fs_mount_t *mp = &fs_mnt;
	struct fs_dir_t dir;
	struct fs_statvfs sbuf;
	int rc;

	fs_dir_t_init(&dir);

	rc = setup_flash(mp);
	if (rc < 0) {
		LOG_ERR("Failed to setup flash area");
		return;
	}

	if (!IS_ENABLED(CONFIG_FAT_FILESYSTEM_ELM)) {
		LOG_INF("No file system selected");
		return;
	}

	rc = mount_app_fs(mp);
	if (rc < 0) {
		LOG_ERR("Failed to mount filesystem");
		return;
	}

	/* Allow log messages to flush to avoid interleaved output */
	k_sleep(K_MSEC(50));

	printk("Mount %s: %d\n", fs_mnt.mnt_point, rc);

	rc = fs_statvfs(mp->mnt_point, &sbuf);
	if (rc < 0) {
		printk("FAIL: statvfs: %d\n", rc);
		return;
	}

	printk("%s: bsize = %lu ; frsize = %lu ;"
	       " blocks = %lu ; bfree = %lu\n",
	       mp->mnt_point,
	       sbuf.f_bsize, sbuf.f_frsize,
	       sbuf.f_blocks, sbuf.f_bfree);

	rc = fs_opendir(&dir, mp->mnt_point);
	printk("%s opendir: %d\n", mp->mnt_point, rc);

	if (rc < 0) {
		LOG_ERR("Failed to open directory");
	}

	while (rc >= 0) {
		struct fs_dirent ent = { 0 };

		rc = fs_readdir(&dir, &ent);
		if (rc < 0) {
			LOG_ERR("Failed to read directory entries");
			break;
		}
		if (ent.name[0] == 0) {
			printk("End of files\n");
			break;
		}
		printk("  %c %u %s\n",
		       (ent.type == FS_DIR_ENTRY_FILE) ? 'F' : 'D',
		       ent.size,
		       ent.name);
	}

	(void)fs_closedir(&dir);

	return;
}

int main(void)
{
	int ret;

	setup_disk();

	ret = app_usb_init();
	if (ret != 0) {
		LOG_ERR("Failed to enable USB");
		return 0;
	}

	LOG_INF("The device is put in USB mass storage mode.\n");
	return 0;
}
```

## src/msc.c
```c
/*
 * Copyright (c) 2016 Intel Corporation.
 * Copyright (c) 2019-2020 Nordic Semiconductor ASA
 * Copyright (c) tinyVision.ai Inc.
 *
 * SPDX-License-Identifier: Apache-2.0
 */

#include <stdio.h>

#include <zephyr/fs/fs.h>
#include <zephyr/kernel.h>
#include <zephyr/logging/log.h>
#include <zephyr/storage/flash_map.h>
#include <zephyr/usb/class/usbd_msc.h>
#include <zephyr/usb/usb_device.h>
#include <zephyr/usb/usbd.h>
#include <zephyr/toolchain.h>

#include <ff.h>

LOG_MODULE_REGISTER(app_msc, LOG_LEVEL_INF);

#if !defined(CONFIG_DISK_DRIVER_FLASH)
#error No supported disk driver enabled
#endif

#define STORAGE_PARTITION_ID FIXED_PARTITION_ID(storage_partition)

static struct fs_mount_t fs_mnt;

USBD_DEFINE_MSC_LUN(nand, "NAND", "Zephyr", "FlashDisk", "0.00");

static int setup_flash(struct fs_mount_t *mnt) {
  int rc = 0;
  unsigned int id;
  const struct flash_area *pfa;

  mnt->storage_dev = (void *)STORAGE_PARTITION_ID;
  id = STORAGE_PARTITION_ID;

  rc = flash_area_open(id, &pfa);
  if (rc < 0) {
    flash_area_close(pfa);
  }

  return rc;
}

static int mount_app_fs(struct fs_mount_t *mnt) {
  int rc;

  static FATFS fat_fs;

  mnt->type = FS_FATFS;
  mnt->fs_data = &fat_fs;
  mnt->mnt_point = "/NAND:";

  rc = fs_mount(mnt);

  return rc;
}

int app_msc_init(void) {
  struct fs_mount_t *mp = &fs_mnt;
  int rc;

  rc = setup_flash(mp);
  if (rc < 0) {
    LOG_ERR("Failed to setup flash area");
    return rc;
  }

  if (!IS_ENABLED(CONFIG_FAT_FILESYSTEM_ELM)) {
    LOG_INF("No file system selected");
    return rc;
  }

  rc = mount_app_fs(mp);
  if (rc < 0) {
    LOG_ERR("Failed to mount filesystem");
    return rc;
  }

  return 0;
}
```

## src/usb.c
```c
#include <zephyr/drivers/usb/udc.h>
#include <zephyr/usb/usbd.h>
#include <zephyr/usb/bos.h>
#include <zephyr/logging/log.h>

LOG_MODULE_REGISTER(app_usb, LOG_LEVEL_DBG);

static const struct device *const udc0_dev = DEVICE_DT_GET(DT_NODELABEL(zephyr_udc0));

USBD_DEVICE_DEFINE(usbd, udc0_dev, 0x1209, 0x0001);

static const struct usb_bos_capability_superspeed_usb bos_cap_ss = {
	.bLength = sizeof(struct usb_bos_capability_superspeed_usb),
	.bDescriptorType = USB_DESC_DEVICE_CAPABILITY,
	.bDevCapabilityType = USB_BOS_CAPABILITY_SUPERSPEED_USB,
	.bmAttributes = 0,
	.wSpeedsSupported = sys_cpu_to_le16(USB_BOS_SPEED_SUPERSPEED_GEN1 |
					    USB_BOS_SPEED_HIGHSPEED | USB_BOS_SPEED_FULLSPEED),
	.bFunctionnalSupport = 1,
	.bU1DevExitLat = 10,
	.wU2DevExitLat = sys_cpu_to_le16(1023),
};

static const struct usb_bos_capability_lpm bos_cap_lpm = {
	.bLength = sizeof(struct usb_bos_capability_lpm),
	.bDescriptorType = USB_DESC_DEVICE_CAPABILITY,
	.bDevCapabilityType = USB_BOS_CAPABILITY_EXTENSION,
	.bmAttributes = USB_BOS_ATTRIBUTES_LPM,
};

USBD_DESC_MANUFACTURER_DEFINE(usbd_manufacturer, "tinyVision.ai");
USBD_DESC_PRODUCT_DEFINE(usbd_product, "tinyCLUNX33");
USBD_DESC_LANG_DEFINE(usbd_lang);
USBD_DESC_CONFIG_DEFINE(usbd_fs_cfg_desc, "FullSpeed Configuration");
USBD_DESC_CONFIG_DEFINE(usbd_hs_cfg_desc, "HighSpeed Configuration");
USBD_DESC_CONFIG_DEFINE(usbd_ss_cfg_desc, "SuperSpeed Configuration");
USBD_DESC_BOS_DEFINE(usbd_bos_cap_ss, sizeof(bos_cap_ss), &bos_cap_ss);
USBD_DESC_BOS_DEFINE(usbd_bos_cap_lpm, sizeof(bos_cap_lpm), &bos_cap_lpm);

USBD_CONFIGURATION_DEFINE(usbd_config_fs, USB_SCD_SELF_POWERED, 100, &usbd_fs_cfg_desc);
USBD_CONFIGURATION_DEFINE(usbd_config_hs, USB_SCD_SELF_POWERED, 100, &usbd_hs_cfg_desc);
USBD_CONFIGURATION_DEFINE(usbd_config_ss, USB_SCD_SELF_POWERED, 100, &usbd_ss_cfg_desc);

int app_usb_init(void)
{
	int ret;

	LOG_DBG("Adding USB descriptors");
	ret = usbd_add_descriptor(&usbd, &usbd_lang);
	if (ret < 0) {
		LOG_ERR("failed to add lang descriptor");
		return ret;
	}
	ret = usbd_add_descriptor(&usbd, &usbd_manufacturer);
	if (ret < 0) {
		LOG_ERR("failed to add manufacturer descriptor");
		return ret;
	}
	ret = usbd_add_descriptor(&usbd, &usbd_product);
	if (ret < 0) {
		LOG_ERR("failed to add product descriptor");
		return ret;
	}
	ret = usbd_add_descriptor(&usbd, &usbd_bos_cap_lpm);
	if (ret < 0) {
		LOG_ERR("failed to add bos_cap_lpm descriptor");
		return ret;
	}
	ret = usbd_add_descriptor(&usbd, &usbd_bos_cap_ss);
	if (ret < 0) {
		LOG_ERR("failed to add bos_cap_ss descriptor");
		return ret;
	}

	LOG_DBG("Adding USB configuration");
	ret = usbd_add_configuration(&usbd, USBD_SPEED_FS, &usbd_config_fs);
	if (ret < 0) {
		LOG_ERR("failed to add FullSpeed, configuration");
		return ret;
	}
	ret = usbd_add_configuration(&usbd, USBD_SPEED_HS, &usbd_config_hs);
	if (ret < 0) {
		LOG_ERR("failed to add HighSpeed, configuration");
		return ret;
	}
	ret = usbd_add_configuration(&usbd, USBD_SPEED_SS, &usbd_config_ss);
	if (ret < 0) {
		LOG_ERR("failed to add SuperSpeed, configuration");
		return ret;
	}

	usbd_device_set_code_triple(&usbd, USBD_SPEED_FS, USB_BCC_MISCELLANEOUS, 0x02, 0x01);
	usbd_device_set_code_triple(&usbd, USBD_SPEED_HS, USB_BCC_MISCELLANEOUS, 0x02, 0x01);
	usbd_device_set_code_triple(&usbd, USBD_SPEED_SS, USB_BCC_MISCELLANEOUS, 0x02, 0x01);

	LOG_DBG("Adding USB classes");
	ret = usbd_register_all_classes(&usbd, USBD_SPEED_FS, 1, NULL);
	if (ret < 0) {
		LOG_ERR("failed to register FullSpeed USB classes");
		return ret;
	}
	ret = usbd_register_all_classes(&usbd, USBD_SPEED_HS, 1, NULL);
	if (ret < 0) {
		LOG_ERR("failed to register HighSpeed USB classes");
		return ret;
	}
	ret = usbd_register_all_classes(&usbd, USBD_SPEED_SS, 1, NULL);
	if (ret < 0) {
		LOG_ERR("failed to register SuperSpeed USB classes");
		return ret;
	}

	LOG_DBG("Finalize USB configuration");
	ret = usbd_init(&usbd);
	if (ret < 0) {
		LOG_ERR("failed to initialize USB");
		return ret;
	}

	LOG_DBG("Starting USB operation");
	ret = usbd_enable(&usbd);
	if (ret < 0) {
		LOG_ERR("failed to enable the USB device");
		return ret;
	}

	return 0;
}
```
