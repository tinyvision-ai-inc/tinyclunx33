## CMakeLists.txt
```
cmake_minimum_required(VERSION 3.20.0)
find_package(Zephyr REQUIRED HINTS $ENV{ZEPHYR_BASE})
project(app)
target_sources(app PRIVATE src/main.c)

# Run some code from RAM for performance during enumeration
zephyr_code_relocate(LIBRARY drivers__usb__udc LOCATION RAM)
zephyr_code_relocate(LIBRARY drivers__usbd LOCATION RAM)
```

## prj.conf
```kconfig
CONFIG_ASSERT=y

# Shell
CONFIG_SHELL=y
CONFIG_I2C_SHELL=y
CONFIG_KERNEL_SHELL=y

# USB
CONFIG_USB_DEVICE_STACK_NEXT=y
CONFIG_USBD_CDC_MUTE_CLASS=y

# Logging
CONFIG_LOG=y
CONFIG_LOG_MODE_MINIMAL=y
CONFIG_UDC_DRIVER_LOG_LEVEL_INF=y
CONFIG_USBD_LOG_LEVEL_INF=y
CONFIG_USBD_CDC_MUTE_LOG_LEVEL_INF=y
```

## app.overlay
```dts
/*
 * Copyright (c) 2025 tinyVision.ai Inc.
 *
 * SPDX-License-Identifier: Apache-2.0
 */

&zephyr_udc0 {
	num-in-endpoints = <3>;
	num-out-endpoints = <2>;
	status = "okay";

	cdc0: zephyr_cdc0 {
		compatible = "zephyr,cdc-mute";
	};
};
```

## src/main.c
```c
#include <zephyr/logging/log.h>

LOG_MODULE_REGISTER(app, LOG_LEVEL_DBG);

int app_usb_init(void);

int main(void)
{
	int ret;

	ret = app_usb_init();
	if (ret != 0) {
		LOG_ERR("Failed to initialize USB");
	}

	return 0;
}
```
